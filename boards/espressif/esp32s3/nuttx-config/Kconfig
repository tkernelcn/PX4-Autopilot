## boards/espressif/esp32s3/nuttx-config/nsh/defconfig
```kconfig
#
# NuttX config for espressif_esp32s3_default (NSH + PX4 rcS).
#
CONFIG_ARCH="xtensa"
CONFIG_ARCH_BOARD_COMMON=y
CONFIG_ARCH_BOARD_CUSTOM=y
CONFIG_ARCH_BOARD_CUSTOM_DIR="../../../../boards/espressif/esp32s3/nuttx-config"
CONFIG_ARCH_BOARD_CUSTOM_DIR_RELPATH=y
CONFIG_ARCH_BOARD_CUSTOM_NAME="px4"
CONFIG_ARCH_CHIP="esp32s3"
CONFIG_ARCH_CHIP_ESP32S3=y
CONFIG_ARCH_CHIP_ESP32S3WROOM1N4=y
CONFIG_ARCH_INTERRUPTSTACK=8192
CONFIG_ARCH_STACKDUMP=y
CONFIG_ARCH_XTENSA=y
CONFIG_BOARDCTL_RESET=y
CONFIG_BOARD_LOOPSPERMSEC=16717
CONFIG_BUILTIN=y
CONFIG_DEBUG_FEATURES=y
CONFIG_DEBUG_FULLOPT=y
CONFIG_DEBUG_SYMBOLS=y
CONFIG_DEFAULT_TASK_STACKSIZE=8192
CONFIG_DEV_GPIO=y
CONFIG_DEV_PIPE_MAXSIZE=4096
CONFIG_ESP32S3_APP_FORMAT_LEGACY=y
CONFIG_ESP32S3_DATA_CACHE_64KB=y
CONFIG_ESP32S3_DATA_CACHE_LINE_64B=y
CONFIG_ESP32S3_FLASH_FREQ_80M=y
CONFIG_ESP32S3_FLASH_MODE_DIO=y
CONFIG_ESP32S3_GPIO_IRQ=y
CONFIG_ESP32S3_I2C1=y
CONFIG_ESP32S3_I2C1_SCLPIN=15
CONFIG_ESP32S3_I2C1_SDAPIN=16
CONFIG_ESP32S3_INSTRUCTION_CACHE_32KB=y
CONFIG_ESP32S3_SPEED_UP_ISR=y
CONFIG_ESP32S3_SPI2=y
CONFIG_ESP32S3_SPI2_CLKPIN=2
CONFIG_ESP32S3_SPI2_CSPIN=1
CONFIG_ESP32S3_SPI2_MISOPIN=41
CONFIG_ESP32S3_SPI2_MOSIPIN=42
CONFIG_ESP32S3_SPIFLASH=y
CONFIG_ESP32S3_SPI_DMA=y
CONFIG_ESP32S3_SPI_DMATHRESHOLD=8
CONFIG_ESP32S3_SPI_DMA_BUFSIZE=4092
CONFIG_ESP32S3_SPI_SWCS=y
CONFIG_ESP32S3_SPI_UDCS=y
CONFIG_ESP32S3_UART0=y
CONFIG_ESP32S3_UART0_RXPIN=44
CONFIG_ESP32S3_UART0_TXPIN=43
CONFIG_ESP32S3_UART1=y
CONFIG_ESP32S3_UART1_RXPIN=18
CONFIG_ESP32S3_UART1_TXPIN=17
CONFIG_ESP32S3_UART2=y
CONFIG_ESP32S3_UART2_RXPIN=3
CONFIG_ESP32S3_UART2_TXPIN=8
CONFIG_ESP32S3_USBSERIAL=y
CONFIG_ETC_CROMFS=y
CONFIG_ETC_ROMFS=y
CONFIG_FS_BINFS=y
CONFIG_FS_CROMFS=y
CONFIG_FS_PROCFS=y
CONFIG_FS_ROMFS=y
CONFIG_HAVE_CXX=y
CONFIG_HAVE_CXXINITIALIZE=y
CONFIG_I2C_DRIVER=y
CONFIG_IDLETHREAD_STACKSIZE=8192
CONFIG_INIT_ENTRYPOINT="nsh_main"
CONFIG_INIT_STACKSIZE=8192
CONFIG_INTELHEX_BINARY=y
CONFIG_BCH=y
CONFIG_MTD_CONFIG=y
CONFIG_MTD_PARTITION_NAMES=y
CONFIG_NSH_ARCHINIT=y
CONFIG_NSH_BUILTIN_APPS=y
CONFIG_NSH_FILEIOSIZE=512
CONFIG_NSH_LINELEN=128
CONFIG_NSH_MAXARGUMENTS=15
CONFIG_NSH_NESTDEPTH=8
CONFIG_NSH_READLINE=y
CONFIG_NSH_CROMFSETC=y
CONFIG_NSH_ROMFSETC=y
CONFIG_NSH_INITSCRIPT="init.d/rcS"
# CONFIG_NSH_ROMFSRC is not set
CONFIG_NSH_VARS=y
CONFIG_PIPES=y
CONFIG_PREALLOC_TIMERS=4
CONFIG_RAMLOG=y
CONFIG_RAMLOG_BUFSIZE=8192
CONFIG_RAMLOG_OVERWRITE=y
CONFIG_RAMLOG_SYSLOG=y
CONFIG_RR_INTERVAL=200
CONFIG_SCHED_HPWORK=y
CONFIG_SCHED_HPWORKPRIORITY=224
CONFIG_SCHED_HPWORKSTACKSIZE=4096
CONFIG_SCHED_INSTRUMENTATION=y
CONFIG_SCHED_INSTRUMENTATION_EXTERNAL=y
CONFIG_SCHED_INSTRUMENTATION_SWITCH=y
CONFIG_SCHED_LPWORK=y
CONFIG_SCHED_LPWORKPRIORITY=100
CONFIG_SCHED_LPWORKSTACKSIZE=4096
CONFIG_SCHED_WAITPID=y
CONFIG_STACK_COLORATION=y
CONFIG_SERIAL_TERMIOS=y
CONFIG_SPI_CALLBACK=y
CONFIG_SPI_DRIVER=y
CONFIG_START_DAY=6
CONFIG_START_MONTH=12
CONFIG_START_YEAR=2011
CONFIG_SIG_DEFAULT=y
CONFIG_SIG_SIGALRM_ACTION=y
CONFIG_SIG_SIGUSR1_ACTION=y
CONFIG_SIG_SIGUSR2_ACTION=y
CONFIG_SYSLOG_BUFFER=y
CONFIG_SYSLOG_CONSOLE=y
CONFIG_SYSLOG_DEVPATH="/dev/kmsg"
CONFIG_SYSLOG_MAX_CHANNELS=2
CONFIG_SYSTEM_NSH=y
CONFIG_TASK_NAME_SIZE=24
CONFIG_USEC_PER_TICK=1000
# CONFIG_UART0_SERIAL_CONSOLE is not set
```

## src/drivers/imu/ww/w688/Kconfig
```kconfig
menuconfig DRIVERS_IMU_WW_W688
	bool "w688"
	default n
	---help---
		Enable support for w688
```

## src/drivers/imu/ww/w689/Kconfig
```kconfig
menuconfig DRIVERS_IMU_WW_W689
	bool "w689"
	default n
	---help---
		Enable support for W689 IMU
```
